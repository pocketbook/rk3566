## buildroot/configs/rockchip_635_recovery_defconfig
```kconfig
BR2_ARM_FPU_NEON=y
BR2_BACKUP_SITE=""
BR2_BINUTILS_VERSION="2.44"
BR2_BINUTILS_VERSION_2_44_X=y
BR2_CCACHE=y
BR2_CCACHE_DIR="$(HOME)/.buildroot-ccache"
BR2_CCACHE_INITIAL_SETUP=""
BR2_CCACHE_USE_BASEDIR=y
BR2_FORCE_HOST_BUILD=y
BR2_GCC_SUPPORTS_LIBCILKRTS=y
BR2_GCC_TARGET_FPU="neon"
BR2_GCC_VERSION="15.2.0"
BR2_GCC_VERSION_15_X=y
BR2_GNU_MIRROR="https://mirrors.ustc.edu.cn/gnu"
BR2_HWCONFIG_PBENV_VALUE="4857430267001239"
BR2_HWCONFIG_VALUE=0
BR2_GCC_VERSION_13_X=y
BR2_LINUX_KERNEL_CUSTOM_LOCAL=y
BR2_LINUX_KERNEL_CUSTOM_LOCAL_LOCATION="$(TOPDIR)/../kernel"
BR2_PACKAGE_BUSYBOX_CONFIG_FRAGMENT_FILES="board/rockchip/common/base/busybox.fragment"
BR2_PACKAGE_BUSYBOX_SHOW_OTHERS=y
BR2_PACKAGE_BZIP2=y
BR2_PACKAGE_C_ARES=y
BR2_PACKAGE_DHCPCD=y
BR2_PACKAGE_DOSFSTOOLS=y
BR2_PACKAGE_DOSFSTOOLS_FATLABEL=y
BR2_PACKAGE_DOSFSTOOLS_FSCK_FAT=y
BR2_PACKAGE_DOSFSTOOLS_MKFS_FAT=y
BR2_PACKAGE_E2FSPROGS=y
BR2_PACKAGE_E2FSPROGS_RESIZE2FS=y
BR2_PACKAGE_EVTEST=y
BR2_PACKAGE_FATRESIZE=y
BR2_PACKAGE_HAS_OPENSSL=y
BR2_PACKAGE_HAS_ZLIB=y
BR2_PACKAGE_HOST_MTOOLS=y
BR2_PACKAGE_HOST_PYTHON3=y
BR2_PACKAGE_HOST_PYTHON3_SSL=y
BR2_PACKAGE_I2C_TOOLS=y
BR2_PACKAGE_JQ=y
BR2_PACKAGE_LIBCURL=y
BR2_PACKAGE_LIBCURL_COOKIES_SUPPORT=y
BR2_PACKAGE_LIBCURL_EXTRA_PROTOCOLS_FEATURES=y
BR2_PACKAGE_LIBCURL_OPENSSL=y
BR2_PACKAGE_LIBCURL_PROXY_SUPPORT=y
BR2_PACKAGE_LIBJPEG=y
BR2_PACKAGE_LIBOPENSSL=y
BR2_PACKAGE_LIBOPENSSL_DYNAMIC_ENGINE=y
BR2_PACKAGE_LIBOPENSSL_ENABLE_BLAKE2=y
BR2_PACKAGE_LIBOPENSSL_ENABLE_BLOWFISH=y
BR2_PACKAGE_LIBOPENSSL_ENABLE_CAST=y
BR2_PACKAGE_LIBOPENSSL_ENABLE_CHACHA=y
BR2_PACKAGE_LIBOPENSSL_ENABLE_COMP=y
BR2_PACKAGE_LIBOPENSSL_ENABLE_DES=y
BR2_PACKAGE_LIBOPENSSL_ENABLE_IDEA=y
BR2_PACKAGE_LIBOPENSSL_ENABLE_MD2=y
BR2_PACKAGE_LIBOPENSSL_ENABLE_MD4=y
BR2_PACKAGE_LIBOPENSSL_ENABLE_MDC2=y
BR2_PACKAGE_LIBOPENSSL_ENABLE_PSK=y
BR2_PACKAGE_LIBOPENSSL_ENABLE_RC2=y
BR2_PACKAGE_LIBOPENSSL_ENABLE_RC4=y
BR2_PACKAGE_LIBOPENSSL_ENABLE_RC5=y
BR2_PACKAGE_LIBOPENSSL_ENABLE_RMD160=y
BR2_PACKAGE_LIBOPENSSL_ENABLE_SEED=y
BR2_PACKAGE_LIBOPENSSL_ENABLE_SSL2=y
BR2_PACKAGE_LIBOPENSSL_ENABLE_SSL3=y
BR2_PACKAGE_LIBOPENSSL_ENABLE_SSL=y
BR2_PACKAGE_LIBOPENSSL_ENABLE_WEAK_SSL=y
BR2_PACKAGE_LIBOPENSSL_ENABLE_WHIRLPOOL=y
BR2_PACKAGE_LIBOPENSSL_TARGET_ARCH="linux-armv4"
BR2_PACKAGE_LIBOPENSSL_UNSECURE=y
BR2_PACKAGE_LIBPTHREAD_STUBS=y
BR2_PACKAGE_LIBTIRPC=y
BR2_PACKAGE_LIBZLIB=y
BR2_PACKAGE_OPENSSL=y
BR2_PACKAGE_P7ZIP=y
BR2_PACKAGE_P7ZIP_7ZA=y
BR2_PACKAGE_PM_UTILS=y
BR2_PACKAGE_PROVIDES_OPENSSL="libopenssl"
BR2_PACKAGE_PROVIDES_ZLIB="libzlib"
BR2_PACKAGE_ROCKCHIP_RGA=y
BR2_PACKAGE_RK3566_RK3568=y
BR2_PACKAGE_ROCKCHIP=y
BR2_PACKAGE_USBMOUNT=y
BR2_PACKAGE_UTIL_LINUX_MOUNT=y
BR2_PACKAGE_ZLIB=y
BR2_PACKAGE_WGET=y
BR2_PACKAGE_LIBCURL_CURL=y

BR2_PACKAGE_WIRELESS_TOOLS=y
BR2_PACKAGE_WPA_SUPPLICANT=y
BR2_PACKAGE_WPA_SUPPLICANT_AUTOSCAN=y
BR2_PACKAGE_WPA_SUPPLICANT_DBUS=y
BR2_PACKAGE_WPA_SUPPLICANT_EAP=y
BR2_PACKAGE_WPA_SUPPLICANT_PASSPHRASE=y
BR2_PACKAGE_WPA_SUPPLICANT_WEXT=y
BR2_PACKAGE_WPA_SUPPLICANT_WPS=y
BR2_PACKAGE_WPA_SUPPLICANT_CTRL_IFACE=y
BR2_PACKAGE_WPA_SUPPLICANT_WPA3=y
BR2_PACKAGE_WPA_SUPPLICANT_CLI=y
BR2_PACKAGE_WPA_SUPPLICANT_WPA_CLIENT_SO=y
BR2_PACKAGE_WPA_SUPPLICANT_NL80211=y
BR2_PB_DEVICE="635"
BR2_PB_VARIANT="U"
BR2_PREBUILD_CLEANUP_EXTERNAL=y
BR2_ROOTFS_PRE_BUILD_SCRIPT="../buildroot-external/pre-build.sh"
BR2_POSTBUILD_COPY_MODULES=y
BR2_POSTBUILD_CREATE_FILES_AND_DIRS=y
BR2_POSTBUILD_WIFIBT_FW=y
BR2_PRIMARY_SITE="https://sources.buildroot.net"
BR2_ROOTFS_DEVICE_CREATION_DYNAMIC_EUDEV=y
BR2_ROOTFS_MERGED_USR=y
BR2_ROOTFS_OVERLAY="../buildroot-external/recovery-overlay/"
BR2_ROOTFS_POST_BUILD_SCRIPT="../buildroot-external/post-build.sh"
BR2_SHARED_STATIC_LIBS=y
BR2_SSP_NONE=y
BR2_SYSTEM_BIN_SH_BUSYBOX=y
BR2_SYSTEM_DEFAULT_PATH="/bin:/sbin:/usr/bin:/usr/sbin"
BR2_TARGET_GENERIC_HOSTNAME="pocketbook"
BR2_TARGET_GENERIC_ISSUE="Welcome to PocketBook"
BR2_TARGET_GENERIC_ROOT_PASSWD="rockchip"
BR2_TARGET_ROOTFS_CPIO=y
BR2_TARGET_ROOTFS_CPIO_GZIP=y
BR2_TARGET_ROOTFS_EXT2=y
BR2_TARGET_ROOTFS_EXT2_4=y
BR2_TARGET_ROOTFS_EXT2_SIZE_AUTO=y
BR2_TARGET_ROOTFS_SQUASHFS=y
BR2_TOOLCHAIN_BUILDROOT_CXX=y
BR2_TOOLCHAIN_PREFER_CLANG=y
BR2_TOOLCHAIN_GCC_AT_LEAST="15"
BR2_TOOLCHAIN_GCC_AT_LEAST_14=y
BR2_TOOLCHAIN_GCC_AT_LEAST_15=y
BR2_WGET="wget --passive-ftp -nd -t 3"
BR2_arm=y
BR2_cortex_a55=y


BR2_PACKAGE_CA_CERTIFICATES=y

BR2_POSTBUILD_COPY_MODULES=y
BR2_POSTBUILD_WIFIBT_FW=y


BR2_PACKAGE_RKSCRIPT=y
# BR2_PACKAGE_RKSCRIPT_USB is not set
# BR2_PACKAGE_RKSCRIPT_IODOMAIN_NOTICE is not set
# BR2_PACKAGE_RKSCRIPT_MOUNTALL is not set
BR2_PACKAGE_RKTOOLKIT=y
```

## buildroot/configs/rockchip_635k3_recovery_defconfig
```kconfig
BR2_arm=y
BR2_cortex_a55=y
BR2_ARM_FPU_NEON=y
BR2_WGET="wget --passive-ftp -nd -t 3"
BR2_PRIMARY_SITE="https://sources.buildroot.net"
BR2_BACKUP_SITE=""
BR2_GNU_MIRROR="https://mirrors.ustc.edu.cn/gnu"
BR2_CCACHE=y
BR2_SHARED_STATIC_LIBS=y
BR2_FORCE_HOST_BUILD=y
BR2_SSP_NONE=y
BR2_TOOLCHAIN_PREFER_CLANG=y
BR2_BINUTILS_VERSION_2_44_X=y
BR2_GCC_VERSION_13_X=y
BR2_TOOLCHAIN_BUILDROOT_CXX=y
BR2_TARGET_GENERIC_HOSTNAME="pocketbook"
BR2_TARGET_GENERIC_ISSUE="Welcome to PocketBook"
BR2_ROOTFS_DEVICE_CREATION_DYNAMIC_EUDEV=y
BR2_ROOTFS_MERGED_USR=y
BR2_TARGET_GENERIC_ROOT_PASSWD="rockchip"
BR2_SYSTEM_BIN_SH_BUSYBOX=y
BR2_SYSTEM_DEFAULT_PATH="/bin:/sbin:/usr/bin:/usr/sbin"
BR2_ROOTFS_OVERLAY="../buildroot-external/recovery-overlay/"
BR2_ROOTFS_PRE_BUILD_SCRIPT="../buildroot-external/pre-build.sh"
BR2_ROOTFS_POST_BUILD_SCRIPT="../buildroot-external/post-build.sh"
BR2_LINUX_KERNEL_CUSTOM_LOCAL=y
BR2_LINUX_KERNEL_CUSTOM_LOCAL_LOCATION="$(TOPDIR)/../kernel"
BR2_PACKAGE_ROCKCHIP=y
BR2_PACKAGE_RK3566_RK3568=y
BR2_PACKAGE_RKSCRIPT=y
# BR2_PACKAGE_RKSCRIPT_IODOMAIN_NOTICE is not set
# BR2_PACKAGE_RKSCRIPT_MOUNTALL is not set
BR2_PACKAGE_RKTOOLKIT=y
BR2_PB_DEVICE="635k3"
BR2_HWCONFIG_PBENV_VALUE="485743026d00fdf2"
BR2_POSTBUILD_COPY_MODULES=y
BR2_POSTBUILD_WIFIBT_FW=y
BR2_POSTBUILD_CREATE_FILES_AND_DIRS=y
BR2_PREBUILD_CLEANUP_EXTERNAL=y
BR2_PACKAGE_BUSYBOX_CONFIG_FRAGMENT_FILES="board/rockchip/common/base/busybox.fragment"
BR2_PACKAGE_BUSYBOX_SHOW_OTHERS=y
BR2_PACKAGE_BZIP2=y
BR2_PACKAGE_P7ZIP=y
BR2_PACKAGE_P7ZIP_7ZA=y
BR2_PACKAGE_JQ=y
BR2_PACKAGE_DOSFSTOOLS=y
BR2_PACKAGE_DOSFSTOOLS_FATLABEL=y
BR2_PACKAGE_DOSFSTOOLS_FSCK_FAT=y
BR2_PACKAGE_DOSFSTOOLS_MKFS_FAT=y
BR2_PACKAGE_E2FSPROGS=y
BR2_PACKAGE_E2FSPROGS_RESIZE2FS=y
BR2_PACKAGE_FATRESIZE=y
BR2_PACKAGE_EVTEST=y
BR2_PACKAGE_I2C_TOOLS=y
BR2_PACKAGE_PM_UTILS=y
BR2_PACKAGE_USBMOUNT=y
BR2_PACKAGE_CA_CERTIFICATES=y
BR2_PACKAGE_C_ARES=y
BR2_PACKAGE_LIBCURL=y
BR2_PACKAGE_LIBCURL_CURL=y
BR2_PACKAGE_LIBTIRPC=y
BR2_PACKAGE_DHCPCD=y
BR2_PACKAGE_WGET=y
BR2_PACKAGE_WIRELESS_TOOLS=y
BR2_PACKAGE_WPA_SUPPLICANT=y
BR2_PACKAGE_WPA_SUPPLICANT_WEXT=y
BR2_PACKAGE_WPA_SUPPLICANT_AUTOSCAN=y
BR2_PACKAGE_WPA_SUPPLICANT_EAP=y
BR2_PACKAGE_WPA_SUPPLICANT_WPS=y
BR2_PACKAGE_WPA_SUPPLICANT_WPA3=y
BR2_PACKAGE_WPA_SUPPLICANT_CLI=y
BR2_PACKAGE_WPA_SUPPLICANT_WPA_CLIENT_SO=y
BR2_PACKAGE_WPA_SUPPLICANT_PASSPHRASE=y
BR2_PACKAGE_WPA_SUPPLICANT_DBUS=y
BR2_PACKAGE_UTIL_LINUX_MOUNT=y
BR2_TARGET_ROOTFS_CPIO=y
BR2_TARGET_ROOTFS_CPIO_GZIP=y
BR2_TARGET_ROOTFS_EXT2=y
BR2_TARGET_ROOTFS_EXT2_4=y
BR2_TARGET_ROOTFS_EXT2_SIZE_AUTO=y
BR2_TARGET_ROOTFS_SQUASHFS=y
BR2_PACKAGE_HOST_MTOOLS=y
BR2_PACKAGE_HOST_PYTHON3=y
BR2_PACKAGE_HOST_PYTHON3_SSL=y
```

## buildroot/package/rockchip/rkebc/Config.in
```kconfig
config BR2_PACKAGE_RKEBC
	bool "rkebc"
	select BR2_PACKAGE_ROCKCHIP_RGA
	select BR2_PACKAGE_LZ4
	select BR2_PACKAGE_INIH
	default y
	help
		rock-chips e-ink service
```

## kernel/drivers/gpu/drm/rockchip/ebc-linux/Kconfig
```kconfig
# SPDX-License-Identifier: GPL-2.0

menuconfig ROCKCHIP_EBC_LINUX
	tristate "EBC"
	depends on ARCH_ROCKCHIP
	select LZ4_DECOMPRESS
	help
	  ebc module for linux sdk.

if ROCKCHIP_EBC_LINUX

config EBC_TPS65185_SENSOR
    bool "eink pmic Tps65185"

config EBC_SY7636A_PMIC
	bool "EINK PMIC SY7636A Support"
	help
	  If you say yes here you get support for the Silergy SY7636A PMIC.

config EBC_SY7673A_PMIC
	bool "EINK PMIC SY7673A Support"
	help
	  If you say yes here you get support for the Silergy SY7673A PMIC.

config EBC_USE_DRM
	bool "Use DRM"
	default y
	help
	  use DRM

config BOOTLOGO_FILE
	bool "Read the dynamic boot logo from a store by default"
	default n
	help
	  Read the dynamic boot logo from BOOTLOGO_FILE_PATH over the logo region
	  u-boot stages out of the logo partition, so the store replaces the
	  flashed default whenever it is there. The store has to be the one
	  configured for the device in hwlib (device_bootlogo_cfg()), which is what
	  the monitor writes the logo to.


config BOOTLOGO_FILE_PATH
	string "Boot logo store"
	depends on BOOTLOGO_FILE
	default "/mnt/secure/bootlogo.bin"
	help
	  A regular file or a partition - it is the same read either way. For a
	  file, its filesystem has to be mounted before this driver is loaded, see
	  S05ebc in the rootfs overlay. Overridden by the logo= module parameter.

config BOOTLOGO_FILE_OFFSET
	hex "Offset of the logo inside BOOTLOGO_FILE_PATH"
	depends on BOOTLOGO_FILE
	default 0x0
	help
	  Leave at 0 for a store holding a single logo. A non zero value lets
	  BOOTLOGO_FILE_PATH name a partition with the logo somewhere inside it.
	  Overridden by the logo_offset= module parameter.

endif
```

## kernel/drivers/input/sensors/accel/stk83xx/Kconfig
```kconfig
config SENSORS_STK83XX
    tristate "sensortek stk83xx accel device driver"
    depends on I2C
    help
        If you say yes here, you get support for the stk83xx.
```

## kernel/drivers/input/touchscreen/focaltech_touch_ft5446/Kconfig
```kconfig
#
# Focaltech Touchscreen driver configuration
#

config TOUCHSCREEN_FTS_5446
    tristate "Focaltech FT5446 Touchscreen"
    default m
    help
      Say Y here if you have Focaltech touch panel.
      If unsure, say N.

config FT_AUTO_UPGRADE
	bool "FW auto upgrade"
	depends on TOUCHSCREEN_FTS_5446
	default n
	help
		Say Y enable fw auto upgrade.
		If unsure, say N.

config FT_UPGRADE_FW_FILE
	depends on TOUCHSCREEN_FTS_5446
	string "Firmware & config file path"
	default "include/pb584/fw_sample.h"
	help
	  path to the firmware & config file.
```

## kernel/drivers/input/touchscreen/focaltech_touch_ft5536/Kconfig
```kconfig
#
# Focaltech Touchscreen driver configuration
#

config TOUCHSCREEN_FT5536
    tristate "Focaltech Touchscreen"
    default n
    help
      Say Y here if you have Focaltech touch panel.
      If unsure, say N.
```

## kernel/drivers/input/touchscreen/ilitek/Kconfig
```kconfig
#
# Focaltech Touchscreen driver configuration
#

config TOUCHSCREEN_ILITEK
    tristate "Ilitek Touchscreen"
    default m
    help
      Say Y here if you have Focaltech touch panel.
      If unsure, say N.

config ILITEK_UPGRADE_FW_FILE
    depends on TOUCHSCREEN_ILITEK
    string "Built-in firmware file"
    default "IL250120J4103E00_V07000004_00000000_0xA9C9_20251205.ili"
    help
      Panel firmware compiled into the driver as CTPM_FW, used when
      /usr/lib/firmware/ilitek_fw.ili is absent. Path is relative to the
      driver directory. This is per-panel: the boot update compares the
      IC's block CRCs against this file and reflashes on any mismatch,
      and the IC-name guard only checks the controller (identical across
      panels), so a blob from another panel would be reflashed on every
      boot. Set it in the device defconfig.
```
