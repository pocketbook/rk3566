## buildroot-external/Config.in
```kconfig
config BR2_PB_DEVICE
	string "Pocketbook device model"
	default ""

config BR2_PB_VARIANT
	string "Pocketbook device variant"
	default "U"

config BR2_HWCONFIG_VALUE
	int "Override HWCONFIG index (leave 0 to use hwconfig from pbenv)"
	default 0

config BR2_HWCONFIG_PBENV_VALUE
	string "Use this HWCONFIG value from pbenv"
	depends on BR2_HWCONFIG_VALUE = 0
    help
      Specify the HWCONFIG value to be used from the pbenv environment
      when BR2_HWCONFIG_VALUE is set to 0

menu "Pre-bulid scripts"
source "../buildroot-external/pre-scripts/Config.in"
endmenu

menu "Post-bulid scripts"
source "../buildroot-external/post-scripts/Config.in"
endmenu

source "../buildroot-external/package/hunspell/Config.in"

config BR2_PREBUILD_CLEANUP_EXTERNAL
	bool "Cleanup external packages, re-download if git source updated"
	default n


source "../buildroot-external/package/glmark2/Config.in"
```

## buildroot-external/package/glmark2/Config.in
```kconfig
config BR2_PACKAGE_GLMARK2
	bool "glmark2"
	depends on BR2_INSTALL_LIBSTDCPP
	select BR2_PACKAGE_JPEG
	select BR2_PACKAGE_LIBDRM if BR2_PACKAGE_GLMARK2_FLAVOR_DRM_GLESV2
	select BR2_PACKAGE_LIBPNG
	help
	  glmark2 is an OpenGL 2.0 and ES 2.0 benchmark.

	  https://github.com/glmark2/glmark2
```

## buildroot-external/post-scripts/Config.in
```kconfig
config BR2_POSTBUILD_COPY_MODULES
	bool "Copy kernel modules to rootfs"
	default n

config BR2_POSTBUILD_WIFIBT_FW
	bool "Copy WIFI/BT firmware to rootfs"
	default n

config BR2_POSTBUILD_CREATE_FILES_AND_DIRS
	bool "Create needed files and dirs in rootfs"
	default n

config BR2_POSTBUILD_CREATE_HWCONFIG
	bool "Create hwconfig file"
	default n

config BR2_POSTBUILD_REMOVE_UNNEEDED_RC_SCRIPTS
	bool "Remove unneeded init.d scripts"
	default n

config BR2_POSTBUILD_FSIMAGE_TAR_GZ
        bool "Generate /ebrmain/fsimage.tar.gz from /ebrmain/content"
        default n

config BR2_POSTBUILD_ZONEINFO_TAR_GZ
        bool "Generate /ebrmain/share/zoneinfo.tar.gz from /ebrmain/share/zoneinfo.lst"
        default n

config BR2_POSTBUILD_GEN_FONTCONFIG_CACHE
        bool "Generate fontconfig cache"
        default n

config BR2_POSTBUILD_CP_MINISWUPDATE_TO_RECOVERY
        bool "Copy mini swupdate to recovery"
        default n
```

## buildroot/configs/rockchip_635_defconfig
```kconfig
BR2_ARM_FPU_NEON=y
BR2_BACKUP_SITE=""
BR2_BINUTILS_VERSION="2.44"
BR2_BINUTILS_VERSION_2_44_X=y
BR2_CCACHE=y
BR2_CCACHE_DIR="$(HOME)/.buildroot-ccache"
BR2_CCACHE_INITIAL_SETUP=""
BR2_CCACHE_USE_BASEDIR=y
BR2_ENABLE_LOCALE_PURGE=n
BR2_GENERATE_LOCALE="C.UTF-8 ar_AE.UTF-8 az_AZ.UTF-8 be_BY.UTF-8 bg_BG.UTF-8 cs_CZ.UTF-8 da_DK.UTF-8 de_DE.UTF-8 el_GR.UTF-8 en_US.UTF-8 es_ES.UTF-8 et_EE.UTF-8 fi_FI.UTF-8 fr_FR.UTF-8 he_IL.UTF-8 hr_HR.UTF-8 hu_HU.UTF-8 hy_AM.UTF-8 is_IS.UTF-8 it_IT.UTF-8 ka_GE.UTF-8 kk_KZ.UTF-8 lt_LT.UTF-8 lv_LV.UTF-8 mk_MK.UTF-8 nl_NL.UTF-8 nn_NO.UTF-8 pl_PL.UTF-8 pt_PT.UTF-8 ro_RO.UTF-8 ru_RU.UTF-8 sk_SK.UTF-8 sl_SI.UTF-8 sv_SE.UTF-8 tr_TR.UTF-8 uk_UA.UTF-8 vi_VN.UTF-8 zh_CN.UTF-8 zh_TW.UTF-8"
BR2_ENABLE_LOCALE_WHITELIST="C.UTF-8 ar_AE.UTF-8 az_AZ.UTF-8 be_BY.UTF-8 bg_BG.UTF-8 cs_CZ.UTF-8 da_DK.UTF-8 de_DE.UTF-8 el_GR.UTF-8 en_US.UTF-8 es_ES.UTF-8 et_EE.UTF-8 fi_FI.UTF-8 fr_FR.UTF-8 he_IL.UTF-8 hr_HR.UTF-8 hu_HU.UTF-8 hy_AM.UTF-8 is_IS.UTF-8 it_IT.UTF-8 ka_GE.UTF-8 kk_KZ.UTF-8 lt_LT.UTF-8 lv_LV.UTF-8 mk_MK.UTF-8 nl_NL.UTF-8 nn_NO.UTF-8 pl_PL.UTF-8 pt_PT.UTF-8 ro_RO.UTF-8 ru_RU.UTF-8 sk_SK.UTF-8 sl_SI.UTF-8 sv_SE.UTF-8 tr_TR.UTF-8 uk_UA.UTF-8 vi_VN.UTF-8 zh_CN.UTF-8 zh_TW.UTF-8"
BR2_SYSTEM_ENABLE_NLS=y
BR2_FORCE_HOST_BUILD=y
BR2_GCC_SUPPORTS_LIBCILKRTS=y
BR2_GCC_TARGET_FPU="neon"
BR2_GCC_VERSION="15.2.0"
BR2_GCC_VERSION_15_X=y
BR2_GNU_MIRROR="https://mirrors.ustc.edu.cn/gnu"
BR2_HWCONFIG_PBENV_VALUE="4857430267001239"
BR2_HWCONFIG_VALUE=0
BR2_LINUX_KERNEL_CUSTOM_LOCAL=y
BR2_LINUX_KERNEL_CUSTOM_LOCAL_LOCATION="$(TOPDIR)/../kernel"
BR2_PACKAGE_ALSA_PLUGINS=y
BR2_PACKAGE_ALSA_UCM_CONF=y
BR2_PACKAGE_ALSA_UTILS=y
BR2_PACKAGE_ALSA_UTILS_ALSACONF=y
BR2_PACKAGE_ALSA_UTILS_ALSALOOP=y
BR2_PACKAGE_ALSA_UTILS_AMIXER=y
BR2_PACKAGE_ALSA_UTILS_APLAY=y
BR2_PACKAGE_AT_SPI2_CORE=y
BR2_PACKAGE_BASH=n
BR2_PACKAGE_BERKELEYDB=y
BR2_PACKAGE_BLUEZ_ALSA_HCITOP=y
BR2_PACKAGE_BLUEZ_TOOLS=y
BR2_PACKAGE_BOOST=y
BR2_PACKAGE_BOOST_ATOMIC=y
BR2_PACKAGE_BOOST_CHRONO=y
BR2_PACKAGE_BOOST_CONTAINER=y
BR2_PACKAGE_BOOST_CONTEXT=y
BR2_PACKAGE_BOOST_CONTEXT_ARCH_SUPPORTS=y
BR2_PACKAGE_BOOST_COROUTINE=y
BR2_PACKAGE_BOOST_DATE_TIME=y
BR2_PACKAGE_BOOST_EXCEPTION=y
BR2_PACKAGE_BOOST_FILESYSTEM=y
BR2_PACKAGE_BOOST_GRAPH=y
BR2_PACKAGE_BOOST_IOSTREAMS=y
BR2_PACKAGE_BOOST_LOCALE=y
BR2_PACKAGE_BOOST_LOG=y
BR2_PACKAGE_BOOST_MATH=y
BR2_PACKAGE_BOOST_PROGRAM_OPTIONS=y
BR2_PACKAGE_BOOST_RANDOM=y
BR2_PACKAGE_BOOST_REGEX=y
BR2_PACKAGE_BOOST_SERIALIZATION=y
BR2_PACKAGE_BOOST_SYSTEM=y
BR2_PACKAGE_BOOST_TEST=y
BR2_PACKAGE_BOOST_THREAD=y
BR2_PACKAGE_BOOST_TIMER=y
BR2_PACKAGE_BOOST_WAVE=y
BR2_PACKAGE_BUSYBOX_CONFIG_FRAGMENT_FILES="board/rockchip/common/base/busybox.fragment"
BR2_PACKAGE_BUSYBOX_SHOW_OTHERS=y
BR2_PACKAGE_BZIP2=y
BR2_PACKAGE_CA_CERTIFICATES=y
BR2_PACKAGE_CHRONY=y
BR2_PACKAGE_CLANG=y
BR2_PACKAGE_C_ARES=y
BR2_PACKAGE_DHCPCD=y
BR2_PACKAGE_DOSFSTOOLS=y
BR2_PACKAGE_DOSFSTOOLS_FATLABEL=y
BR2_PACKAGE_DOSFSTOOLS_FSCK_FAT=y
BR2_PACKAGE_DOSFSTOOLS_MKFS_FAT=y
BR2_PACKAGE_DROPBEAR=y
BR2_PACKAGE_DROPBEAR_NO_AUTH_MODE=y
BR2_PACKAGE_EVTEST=y
BR2_PACKAGE_EXFAT=y
BR2_PACKAGE_EXFAT_UTILS=y
BR2_PACKAGE_EXIV2=y
BR2_PACKAGE_EXIV2_PNG=y
BR2_PACKAGE_FAAD2=y
BR2_PACKAGE_FATRESIZE=y
BR2_PACKAGE_FFMPEG=y
BR2_PACKAGE_FFMPEG_SWSCALE=y
BR2_PACKAGE_FLAC=y
BR2_PACKAGE_FLUIDSYNTH=y
BR2_PACKAGE_FONTCONFIG=y
BR2_PACKAGE_FREETYPE=y
BR2_PACKAGE_GDB=y
BR2_PACKAGE_GDB_DEBUGGER=y
BR2_PACKAGE_GDB_SERVER=y
BR2_PACKAGE_GDB_TUI=y
BR2_PACKAGE_GDK_PIXBUF=y
BR2_PACKAGE_GIFLIB=y
BR2_PACKAGE_GPTFDISK=y
BR2_PACKAGE_GTEST=y
BR2_PACKAGE_GTEST_GMOCK=y
BR2_PACKAGE_HARFBUZZ=n
BR2_PACKAGE_HAS_JPEG=y
BR2_PACKAGE_HOST_CMAKE=y
BR2_PACKAGE_HOST_DOSFSTOOLS=y
BR2_PACKAGE_HOST_ENVIRONMENT_SETUP=y
BR2_PACKAGE_HOST_IMAGEMAGICK=n
BR2_PACKAGE_HOST_MTOOLS=y
BR2_PACKAGE_HOST_PYTHON3=y
BR2_PACKAGE_HOST_PYTHON3_SSL=y
BR2_PACKAGE_I2C_TOOLS=y
BR2_PACKAGE_ICU=y
BR2_PACKAGE_IMAGEMAGICK=n
BR2_PACKAGE_INIH=y
BR2_PACKAGE_IPERF=y
BR2_PACKAGE_IW=y
BR2_PACKAGE_JPEG_TURBO=y
BR2_PACKAGE_JQ=y
BR2_PACKAGE_JSONCPP=y
BR2_PACKAGE_JSON_C=y
BR2_PACKAGE_LAME=y
BR2_PACKAGE_LIBBSD=y
BR2_PACKAGE_LIBMD=y
BR2_PACKAGE_LIBCURL_CURL=y
BR2_PACKAGE_LIBCURL_VERBOSE=y
BR2_PACKAGE_LIBDRM_INSTALL_TESTS=y
BR2_PACKAGE_LIBEXIF=y
BR2_PACKAGE_LIBGUDEV=y
BR2_PACKAGE_LIBJSON=y
BR2_PACKAGE_LIBMAD=y
BR2_PACKAGE_LIBNSS=y
BR2_PACKAGE_LIBOPENSSL_BIN=y
BR2_PACKAGE_LIBPNG=y
BR2_PACKAGE_LIBSOUP3=y
BR2_PACKAGE_LIBCURL=y
BR2_PACKAGE_LIBCURL_COOKIES_SUPPORT=y
BR2_PACKAGE_LIBCURL_EXTRA_PROTOCOLS_FEATURES=y
BR2_PACKAGE_LIBCURL_OPENSSL=y
BR2_PACKAGE_LIBCURL_PROXY_SUPPORT=y
BR2_PACKAGE_LIBOPENSSL=y
BR2_PACKAGE_LIBOPENSSL_DYNAMIC_ENGINE=y
BR2_PACKAGE_LIBOPENSSL_ENABLE_BLAKE2=y
BR2_PACKAGE_LIBOPENSSL_ENABLE_BLOWFISH=y
BR2_PACKAGE_LIBOPENSSL_ENABLE_CAST=y
BR2_PACKAGE_LIBOPENSSL_ENABLE_CHACHA=y
BR2_PACKAGE_LIBOPENSSL_ENABLE_COMP=y
BR2_PACKAGE_LIBOPENSSL_ENABLE_DES=y
BR2_PACKAGE_LIBOPENSSL_ENABLE_IDEA=y
BR2_PACKAGE_LIBOPENSSL_ENABLE_MD2=y
BR2_PACKAGE_LIBOPENSSL_ENABLE_MD4=y
BR2_PACKAGE_LIBOPENSSL_ENABLE_MDC2=y
BR2_PACKAGE_LIBOPENSSL_ENABLE_PSK=y
BR2_PACKAGE_LIBOPENSSL_ENABLE_RC2=y
BR2_PACKAGE_LIBOPENSSL_ENABLE_RC4=y
BR2_PACKAGE_LIBOPENSSL_ENABLE_RC5=y
BR2_PACKAGE_LIBOPENSSL_ENABLE_RMD160=y
BR2_PACKAGE_LIBOPENSSL_ENABLE_SEED=y
BR2_PACKAGE_LIBOPENSSL_ENABLE_SSL2=y
BR2_PACKAGE_LIBOPENSSL_ENABLE_SSL3=y
BR2_PACKAGE_LIBOPENSSL_ENABLE_SSL=y
BR2_PACKAGE_LIBOPENSSL_ENABLE_WEAK_SSL=y
BR2_PACKAGE_LIBOPENSSL_ENABLE_WHIRLPOOL=y
BR2_PACKAGE_LIBOPENSSL_TARGET_ARCH="linux-armv4"
BR2_PACKAGE_LIBOPENSSL_UNSECURE=y
BR2_PACKAGE_LIBPTHREAD_STUBS=y
BR2_PACKAGE_LIBTIRPC=y
BR2_PACKAGE_LIBZLIB=y
BR2_PACKAGE_OPENSSL=y
BR2_PACKAGE_LIBVORBIS=y
BR2_PACKAGE_LIBXKBCOMMON=y
BR2_PACKAGE_LIBXSLT=y
BR2_PACKAGE_LLVM_RTTI=y
BR2_PACKAGE_LRZSZ=y
BR2_PACKAGE_LSOF=y
BR2_PACKAGE_LTRACE=y
BR2_PACKAGE_LZ4=y
BR2_PACKAGE_MAKE=y
BR2_PACKAGE_MEMSTAT=y
BR2_PACKAGE_MEMTESTER=y
BR2_PACKAGE_MPG123=y
BR2_PACKAGE_MTDEV=y
BR2_PACKAGE_MTOOLS=y
BR2_PACKAGE_NUMACTL=y
BR2_PACKAGE_OPENCV4=y
BR2_PACKAGE_OPENCV4_LIB_HIGHGUI=y
BR2_PACKAGE_OPUS=y
BR2_PACKAGE_OVERRIDE_FILE="$(TOPDIR)/local.mk"
BR2_PACKAGE_P7ZIP=y
BR2_PACKAGE_P7ZIP_7ZA=y
BR2_PACKAGE_PANGO=n
BR2_PACKAGE_PCRE=y
BR2_PACKAGE_PCRE_UCP=y
BR2_PACKAGE_PM_UTILS=y
BR2_PACKAGE_PROVIDES_OPENSSL="libopenssl"
BR2_PACKAGE_PROVIDES_ZLIB="libzlib"
BR2_PACKAGE_PROCPS_NG=y
BR2_PACKAGE_PROCRANK_LINUX=y
BR2_PACKAGE_PROVIDES_JPEG="jpeg-turbo"
BR2_PACKAGE_RECOVERY=y
BR2_PACKAGE_RECOVERY_NO_UI=y
BR2_PACKAGE_RECOVERY_USE_UPDATEENGINE=y
BR2_PACKAGE_RK3566_RK3568=y

BR2_PACKAGE_RKSCRIPT=y
# BR2_PACKAGE_RKSCRIPT_USB is not set
# BR2_PACKAGE_RKSCRIPT_IODOMAIN_NOTICE is not set
# BR2_PACKAGE_RKSCRIPT_MOUNTALL is not set
BR2_PACKAGE_RKTOOLKIT=y

BR2_PACKAGE_ROCKCHIP=y
BR2_PACKAGE_ROCKCHIP_MALI=y
BR2_PACKAGE_ROCKCHIP_MPP=y
BR2_PACKAGE_ROCKCHIP_MPP_ALLOCATOR_DRM=y
BR2_PACKAGE_ROCKCHIP_MPP_TESTS=y
BR2_PACKAGE_ROCKCHIP_RGA=y
BR2_PACKAGE_RTMPDUMP=y
BR2_PACKAGE_SOX=y
BR2_PACKAGE_SQLITE_ENABLE_COLUMN_METADATA=y
BR2_PACKAGE_SQLITE_ENABLE_FTS3=y
BR2_PACKAGE_SQLITE_ENABLE_JSON1=y
BR2_PACKAGE_STRACE=y
BR2_PACKAGE_TAGLIB=y
BR2_PACKAGE_TIFF=y
BR2_PACKAGE_UTIL_LINUX_LIBMOUNT=y
BR2_PACKAGE_VALGRIND=y
BR2_PACKAGE_VALGRIND_SGCHECK=y
BR2_PACKAGE_WEBP=y
BR2_PACKAGE_WEBP_DEMUX=y
BR2_PACKAGE_WEBP_MUX=y
BR2_PACKAGE_WGET=y
BR2_PACKAGE_WIRELESS_TOOLS=y
BR2_PACKAGE_WPA_SUPPLICANT=y
BR2_PACKAGE_WPA_SUPPLICANT_AUTOSCAN=y
BR2_PACKAGE_WPA_SUPPLICANT_DBUS=y
BR2_PACKAGE_WPA_SUPPLICANT_EAP=y
BR2_PACKAGE_WPA_SUPPLICANT_PASSPHRASE=y
BR2_PACKAGE_WPA_SUPPLICANT_WEXT=y
BR2_PACKAGE_WPA_SUPPLICANT_WPS=y
BR2_PACKAGE_XUTIL_UTIL_MACROS=y
BR2_PACKAGE_XZ=y
BR2_PACKAGE_ZIP=y
BR2_PB_DEVICE="635"
BR2_PB_VARIANT="U"
BR2_POSTBUILD_COPY_MODULES=y
BR2_POSTBUILD_CREATE_FILES_AND_DIRS=y
BR2_POSTBUILD_CREATE_HWCONFIG=y
BR2_POSTBUILD_REMOVE_UNNEEDED_RC_SCRIPTS=y
BR2_POSTBUILD_WIFIBT_FW=y
BR2_POSTBUILD_FSIMAGE_TAR_GZ=y
BR2_POSTBUILD_ZONEINFO_TAR_GZ=y
BR2_PRIMARY_SITE="https://sources.buildroot.net"
BR2_PREBUILD_CLEANUP_EXTERNAL=y
BR2_ROOTFS_DEVICE_CREATION_DYNAMIC_EUDEV=y
BR2_ROOTFS_MERGED_USR=y
BR2_ROOTFS_OVERLAY="../buildroot-external/rootfs-overlay/"
BR2_ROOTFS_POST_BUILD_SCRIPT="../buildroot-external/post-build.sh"
BR2_ROOTFS_PRE_BUILD_SCRIPT="../buildroot-external/pre-build.sh"
BR2_SHARED_STATIC_LIBS=y
BR2_SSP_NONE=y
BR2_SYSTEM_BIN_SH_BUSYBOX=y
BR2_SYSTEM_DEFAULT_PATH="/bin:/sbin:/usr/bin:/usr/sbin"
BR2_TARGET_GENERIC_HOSTNAME="pocketbook"
BR2_TARGET_GENERIC_ISSUE="Welcome to PocketBook"
BR2_TARGET_ROOTFS_CPIO=n
BR2_TARGET_ROOTFS_CPIO_GZIP=n
BR2_TARGET_ROOTFS_EXT2=y
BR2_TARGET_ROOTFS_EXT2_4=y
BR2_TARGET_ROOTFS_EXT2_SIZE_AUTO=y
BR2_TARGET_ROOTFS_SQUASHFS=n
BR2_TARGET_ROOTFS_TAR=n
BR2_TOOLCHAIN_BUILDROOT_CXX=y
BR2_TOOLCHAIN_GCC_AT_LEAST="15"
BR2_TOOLCHAIN_GCC_AT_LEAST_14=y
BR2_TOOLCHAIN_GCC_AT_LEAST_15=y
BR2_WGET="wget --passive-ftp -nd -t 3"
BR2_arm=y
BR2_cortex_a55=y

BR2_PACKAGE_WPA_SUPPLICANT_CTRL_IFACE=y
BR2_PACKAGE_WPA_SUPPLICANT_WPA3=y
BR2_PACKAGE_WPA_SUPPLICANT_CLI=y
BR2_PACKAGE_WPA_SUPPLICANT_WPA_CLIENT_SO=y

BR2_PACKAGE_DBUS_GLIB=y

BR2_PACKAGE_BLUEZ5_UTILS=y
BR2_PACKAGE_BLUEZ5_UTILS_CLIENT=y
BR2_PACKAGE_BLUEZ5_UTILS_TOOLS=y
BR2_PACKAGE_BLUEZ5_UTILS_EXPERIMENTAL=n
BR2_PACKAGE_BLUEZ5_UTILS_OBEX=y
BR2_PACKAGE_BLUEZ5_UTILS_DEPRECATED=y
BR2_PACKAGE_BLUEZ5_UTILS_MONITOR=y
BR2_PACKAGE_BLUEZ5_UTILS_PLUGINS_AUDIO=y
BR2_PACKAGE_BLUEZ5_UTILS_PLUGINS_NETWORK=y

BR2_PACKAGE_BLUEZ_ALSA=y

BR2_PACKAGE_BLUEZ5_UTILS=y
BR2_PACKAGE_BLUEZ5_ALSA=y
BR2_PACKAGE_BLUEZ5_AUDIO=y
BR2_PACKAGE_BLUEZ5_OBEX=y
BR2_PACKAGE_BLUEZ5_TOOLS=y
BR2_PACKAGE_DBUS=y


BR2_PACKAGE_BLUEZ_TOOLS=y

BR2_PACKAGE_ALSA_LIB=y
BR2_PACKAGE_ALSA_LIB_DEVDIR="/dev/snd"
BR2_PACKAGE_ALSA_LIB_PCM_PLUGINS="all"
BR2_PACKAGE_ALSA_LIB_CTL_PLUGINS="all"
BR2_PACKAGE_ALSA_LIB_ALOAD=y
BR2_PACKAGE_ALSA_LIB_MIXER=y
BR2_PACKAGE_ALSA_LIB_PCM=y
BR2_PACKAGE_ALSA_LIB_RAWMIDI=y
BR2_PACKAGE_ALSA_LIB_HWDEP=y
BR2_PACKAGE_ALSA_LIB_SEQ=y
BR2_PACKAGE_ALSA_LIB_UCM=y
BR2_PACKAGE_ALSA_LIB_ALISP=y
BR2_PACKAGE_ALSA_LIB_OLD_SYMBOLS=y
BR2_PACKAGE_ALSA_LIB_TOPOLOGY=y

BR2_TARGET_GENERIC_REMOUNT_ROOTFS_RW=n

BR2_PACKAGE_GLMARK2=y
```
